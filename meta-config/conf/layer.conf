## meta-config/conf/layer.conf
```bitbake
# We have a conf and classes directory, add to BBPATH
BBPATH .= ":${LAYERDIR}"

# We have recipes-* directories, add to BBFILES
BBFILES += "${LAYERDIR}/recipes-*/*/*.bb \
            ${LAYERDIR}/recipes-*/*/*.bbappend"

BBFILE_COLLECTIONS += "meta-config"
BBFILE_PATTERN_meta-config = "^${LAYERDIR}/"
BBFILE_PRIORITY_meta-config = "6"

LAYERDEPENDS_meta-config = "core"
LAYERSERIES_COMPAT_meta-config = "scarthgap"
```
